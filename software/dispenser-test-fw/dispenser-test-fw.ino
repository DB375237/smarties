/*
 * Copyright © 2020-2021 DB375237 (Dario B.)
* Permission is hereby granted, free of charge, to any person obtaining a copy of this software and associated documentation files (the "Software"), 
* to deal in the Software without restriction, including without limitation the rights to use, copy, modify, merge, publish, distribute, sublicense,
* and/or sell copies of the Software, and to permit persons to whom the Software is furnished to do so, subject to the following conditions:
* 
* The above copyright notice and this permission notice shall be included in all copies or substantial portions of the Software.
* THE SOFTWARE IS PROVIDED "AS IS", WITHOUT WARRANTY OF ANY KIND, EXPRESS OR IMPLIED, INCLUDING BUT NOT LIMITED TO THE WARRANTIES OF MERCHANTABILITY,
* FITNESS FOR A PARTICULAR PURPOSE AND NONINFRINGEMENT. IN NO EVENT SHALL THE AUTHORS OR COPYRIGHT HOLDERS BE LIABLE FOR ANY CLAIM,
* DAMAGES OR OTHER LIABILITY, WHETHER IN AN ACTION OF CONTRACT, TORT OR OTHERWISE, ARISING FROM,
* OUT OF OR IN CONNECTION WITH THE SOFTWARE OR THE USE OR OTHER DEALINGS IN THE SOFTWARE.
*/

#define DEBUG

#ifdef DEBUG
#define DEBUG_PRINT(x)    Serial.print(x)
#define DEBUG_PRINTHEX(x) Serial.print(x, HEX);
#define DEBUG_PRINTLN(x)  Serial.println(x)
#else
#define DEBUG_PRINT(x)
#define DEBUG_PRINTHEX(x)
#define DEBUG_PRINTLN(x)
#endif

#include <Wire.h>
#include <Adafruit_GFX.h>
#include <Adafruit_SSD1306.h>
#include <Adafruit_NeoPixel.h>
#include "dwStepperDriver.h"

#define SCREEN_WIDTH 128 // OLED display width, in pixels
#define SCREEN_HEIGHT 32 // OLED display height, in pixels
#define OLED_RESET     4 // Reset pin # (or -1 if sharing Arduino reset pin)
#define SCREEN_ADDRESS 0x3C //< See datasheet for Address; 0x3D for 128x64, 0x3C for 128x32

#define NUMPIXELS         24
#define DEFAULT_INTENSITY 64 //8 = 30mA, 16 = 40mA, 32 = 60mA, 64 = 80mA, 128 = 160mA (1 colore)

#define STEP_NUM          200

#define DROP_SENSOR_PIN   2 //OK
#define CAROUSEL_DIR_PIN  3
#define CAROUSEL_STEP_PIN 4
#define PLATTER_DIR_PIN   5 //OK
#define PLATTER_STEP_PIN  6 //OK
#define EMPTY_SENSOR_PIN  7 //OK
#define CAROUSEL_HOME_PIN 8 //OK
#define DROP_BTN_PIN      9 //OK
#define ROTATE_BTN_PIN    10 //OK
#define PLATTER_HOME_PIN  11 //OK
#define PIXEL_RING_PIN    12 //OK
#define TRAY_SENSOR_D_PIN 13 //OK

#define BT_STATUS_PIN     A0 //OK
#define TRAY_SENSOR_A_PIN A1 //OK

char str_buffer[100];

Adafruit_NeoPixel pixels(NUMPIXELS, PIXEL_RING_PIN, NEO_GRB + NEO_KHZ800);
Adafruit_SSD1306 display(SCREEN_WIDTH, SCREEN_HEIGHT, &Wire, OLED_RESET);
dwStepperDriver platterStepper(STEP_NUM, dwStepperDriver::SIXTEENTH_STEP, PLATTER_DIR_PIN, PLATTER_STEP_PIN, PLATTER_HOME_PIN);
dwStepperDriver carouselStepper(STEP_NUM, dwStepperDriver::SIXTEENTH_STEP, CAROUSEL_DIR_PIN, CAROUSEL_STEP_PIN, CAROUSEL_HOME_PIN);

volatile int counter = 0;
bool isTubeEmpty;

const unsigned char myBitmap [] PROGMEM = {
  0x00, 0x00, 0x00, 0x00, 0x00, 0x00, 0x00, 0x00, 0x00, 0x00, 0x00, 0x78, 0x00, 0x00, 0x00, 0x00, 
  0x00, 0x1f, 0xe0, 0x00, 0x00, 0x00, 0x00, 0x00, 0x00, 0x00, 0x00, 0xfc, 0x00, 0x00, 0x00, 0x00, 
  0x00, 0x3f, 0xf0, 0x00, 0x00, 0x00, 0x00, 0x00, 0x3c, 0x00, 0x01, 0xfc, 0x00, 0x00, 0x1f, 0xc0, 
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  0x00, 0xfc, 0x00, 0x00, 0x00, 0x00, 0x00, 0x00, 0x00, 0x00, 0x00, 0x00, 0x00, 0x00, 0x00, 0x00

};

void setup() {
  // put your setup code here, to run once:
  pinMode(DROP_SENSOR_PIN, INPUT);
  pinMode(EMPTY_SENSOR_PIN, INPUT); 
  pinMode(TRAY_SENSOR_D_PIN, OUTPUT);
  pinMode(PIXEL_RING_PIN, OUTPUT); 
  pinMode(TRAY_SENSOR_A_PIN, INPUT);      
  pinMode(BT_STATUS_PIN, INPUT);      
  pinMode(DROP_BTN_PIN, INPUT_PULLUP);
  pinMode(ROTATE_BTN_PIN, INPUT_PULLUP);

  attachInterrupt(digitalPinToInterrupt(DROP_SENSOR_PIN), pin_ISR_CHANGE, CHANGE);  
  
  // initialize serial:
  Serial.begin(9600);

  // SSD1306_SWITCHCAPVCC = generate display voltage from 3.3V internally
  if(!display.begin(SSD1306_SWITCHCAPVCC, SCREEN_ADDRESS)) {
    Serial.println(F("SSD1306 allocation failed"));
    for(;;); // Don't proceed, loop forever
  }

  drawLogo();
  
  pixels.begin(); // INITIALIZE NeoPixel strip object (REQUIRED)
  pixels.clear(); // Set all pixel colors to 'off'
  pixels.show();   // Send the updated pixel colors to the hardware.

  setRingColor(DEFAULT_INTENSITY, 0, 0);
  delay(1000);  

  setRingColor(0, DEFAULT_INTENSITY, 0);
  delay(1000);  

  setRingColor(0, 0, DEFAULT_INTENSITY);
  delay(1000);  

  setRingColor(DEFAULT_INTENSITY, DEFAULT_INTENSITY, DEFAULT_INTENSITY);
  delay(1000);  

  platterStepper.setRPM(20);
  if(platterStepper.home()) {
    DEBUG_PRINTLN("HOMED 1");    
  }
  delay(1000);

  carouselStepper.setRPM(20);
  if(carouselStepper.home()) {
    DEBUG_PRINTLN("HOMED 2");    
  }

  delay(1000);
}

void pin_ISR_CHANGE() {
  counter++;
}

void drawLogo(void) {
  display.clearDisplay();

  display.drawBitmap(0, 0, myBitmap, SCREEN_WIDTH, SCREEN_HEIGHT, WHITE);
  
  display.display();
  delay(1000);
}

void loop() { 
  if(LOW == digitalRead(ROTATE_BTN_PIN)){
    carouselStepper.rotate(125);
    //delay(1000);
  }    

  if(LOW == digitalRead(DROP_BTN_PIN)){
    counter = 0;
    platterStepper.rotate(250);
    delay(500);
    isTubeEmpty = (HIGH == digitalRead(EMPTY_SENSOR_PIN));    
    DEBUG_PRINTLN(isTubeEmpty ? "Empty": "Qty OK");
    if(isTubeEmpty){
      setRingColor(DEFAULT_INTENSITY, 0, 0);
    }else{
      setRingColor(0, DEFAULT_INTENSITY, 0);      
    }
    delay(500);
    platterStepper.rotate(-250);
    delay(500);
    if(2 == counter){
      DEBUG_PRINTLN("Dropped");      
      setRingColor(0, DEFAULT_INTENSITY, 0);
    }else if(!isTubeEmpty){
      DEBUG_PRINTLN("Stuck");            
      setRingColor(DEFAULT_INTENSITY, 0, 0);
    }
    delay(500);   
    setRingColor(DEFAULT_INTENSITY, DEFAULT_INTENSITY, DEFAULT_INTENSITY);    
  }
}

/***************************************************************
   setRingColor()
 ***************************************************************/
void setRingColor(uint8_t r, uint8_t g, uint8_t b) {
  pixels.clear(); // Set all pixel colors to 'off'
  for (int i = 0; i < NUMPIXELS; i++) { // For each pixel...
    // pixels.Color() takes RGB values, from 0,0,0 up to 255,255,255
    pixels.setPixelColor(i, pixels.Color(r, g, b));
  }
  pixels.show();   // Send the updated pixel colors to the hardware.
}
